## CMakeLists.txt
```
# SPDX-License-Identifier: Apache-2.0

cmake_minimum_required(VERSION 3.20.0)

find_package(Zephyr REQUIRED HINTS $ENV{ZEPHYR_BASE})
project(led_blink)

target_sources(app PRIVATE src/main.c src/gpio_operations.c 
                src/ble_operations.c
                src/ble_advertise.c
                src/ble_service.c
                src/LED_service_functions.c)
```

## prj.conf
```kconfig
# Logger module
CONFIG_LOG=y

# Include source code for GPIOs
CONFIG_GPIO=y

# Bluetooth LE
CONFIG_BT=y
CONFIG_BT_PERIPHERAL=y
CONFIG_BT_DEVICE_NAME="BLE_LED"

# Increase stack size for the main thread and System Workqueue 
CONFIG_SYSTEM_WORKQUEUE_STACK_SIZE=2048
CONFIG_MAIN_STACK_SIZE=2048
```

## src/main.c
```c
/*
 * Copyright (c) 2012-2014 Wind River Systems, Inc.
 *
 * SPDX-License-Identifier: Apache-2.0
 */

#include "headers.h"


void main(void)
{
	printk("Hello BLE-LED! \r\n");
	gpio_configure();
	ble_config();
	
	while(1)
	{
		// toggle_both();
		// k_msleep(LED_DELAY);
		k_msleep(IDLE_DELAY);
	}
	
}
```

## src/LED_service_functions.c
```c
#include"headers.h"

/*
    Define the application callback function for controlling the LED from mobile
*/
static void app_led_cb(bool led_state)
{
	turn_ble_led_on_off((int)led_state);
}

/* Declare a varaible app_callbacks of type my_led_cb and initiate its members to the applications call back functions .*/
static struct my_led_cb app_callbacks = {
	.led_cb    = app_led_cb,
	// .button_cb = app_button_cb,
};

void register_led_service_characteristics()
{
	int err;
	err = my_led_service_init(&app_callbacks);
	if (err) {
		printk("Failed to init LED service (err:%d)\n", err);
		return;
	}
}
```

## src/LED_service_functions.h
```c
#ifndef LED_SERVICE_FUNCTIONS_H
#define LED_SERVICE_FUNCTIONS_H

/*
	Function to register our defined service characteristics having callback information
*/
void register_led_service_characteristics(void);

#endif
```

## src/ble_advertise.c
```c
#include"headers.h"

// advertise parameters
static struct bt_le_adv_param *adv_param = BT_LE_ADV_PARAM((BT_LE_ADV_OPT_CONNECTABLE|BT_LE_ADV_OPT_USE_IDENTITY), /* Connectable advertising and use identity address */
                800, /*Min Advertising Interval 500ms (800*0.625ms) */
                801, /*Max Advertising Interval 500.625ms (801*0.625ms)*/
                NULL); /* Set to NULL for undirected advertising*/

// Prepare advertising data
static const struct bt_data ad[] = {
	BT_DATA_BYTES(BT_DATA_FLAGS, (BT_LE_AD_GENERAL | BT_LE_AD_NO_BREDR)),
	BT_DATA(BT_DATA_NAME_COMPLETE, DEVICE_NAME, DEVICE_NAME_LEN),

};

// Prepare Scan Response
static const struct bt_data sd[] = {
	BT_DATA_BYTES(BT_DATA_UUID128_ALL, BT_UUID_DS_VAL),
};

/*
    This function advertises the BLE Service
*/
void ble_advertise()
{
    int err;
    // Start BLE Advertising
    err = bt_le_adv_start(adv_param, ad, ARRAY_SIZE(ad),
			      sd, ARRAY_SIZE(sd));
	if (err) {
		printf("Advertising failed to start (err %d)\n", err);
		return;
	}

	printf("Advertising successfully started\n");
}
```

## src/ble_advertise.h
```c
#ifndef BLE_ADVERTISE_H
#define BLE_ADVERTISE_H

#define DEVICE_NAME             CONFIG_BT_DEVICE_NAME
#define DEVICE_NAME_LEN         (sizeof(DEVICE_NAME) - 1)

// advertise service 
void ble_advertise(void);

#endif
```

## src/ble_operations.c
```c
#include"headers.h"

/*
    This function configure the BLE 
*/

void ble_config()
{
    int err;
	bt_addr_le_t addr;

/*-----------If you want to change the default address-----------------------*/    
    // Change BLE Address
	err = bt_addr_le_from_str("FF:EE:DD:CC:BB:AA", "random", &addr);
	if(err) {
		printk("Invalid BT address");
	}

    // Change BLE Address
    err = bt_id_create(&addr, NULL);
    if (err < 0) {
        printk("Creating new ID failed (err %d)\n", err);
    }
/*------------------------------------------------------------------------*/
    
    // Enable the BLE
    err = bt_enable(NULL);
	if (err) {
		printf("Bluetooth init failed (err %d)\n", err);
		return;
	}

    // register service characteristics callbacks
    register_led_service_characteristics();

    // Advertise Service
    ble_advertise();

    // register callback
    register_callback();

}
```

## src/ble_operations.h
```c
#ifndef BLE_OPERATIONS_H
#define BLE_OPERATIONS_H

/****Configure BLE*****/
void ble_config(void);

#endif
```

## src/ble_service.c
```c
/*
    This file contain functions related to callback and services
*/
#include"headers.h"


struct bt_conn *my_conn = NULL;

// Conncetion callback to indicate connected and disconnected state
struct bt_conn_cb connection_callbacks = {
    .connected              = on_connected,
    .disconnected           = on_disconnected,
};

/*------on_connected Call Back--------*/
void on_connected(struct bt_conn *conn, uint8_t err)
{
    if (err) {
        printf("Connection error %d\n", err);
        return;
    }
    printf("Connected\n");
    my_conn = bt_conn_ref(conn);

    /* Turn ON Green LED */
    turn_green_led_on_off(1);
}

/*------on_disconnected Call Back--------*/
void on_disconnected(struct bt_conn *conn, uint8_t reason)
{
    printf("Disconnected. Reason %d\n", reason);
    bt_conn_unref(my_conn);

    /* Turn OFF Green LED */
    turn_green_led_on_off(0);
}

/*-------LED Characteristic Callback-----------*/
static struct my_led_cb       led_cb;
static ssize_t write_led_callback(struct bt_conn *conn,
			 const struct bt_gatt_attr *attr,
			 const void *buf,
			 uint16_t len, uint16_t offset, uint8_t flags)
{
	// LOG_DBG("Attribute write, handle: %u, conn: %p", attr->handle,
	// 	(void *)conn);
	if (len != 1U) {
		// LOG_DBG("Write led: Incorrect data length");
		return BT_GATT_ERR(BT_ATT_ERR_INVALID_ATTRIBUTE_LEN);
	}
	if (offset != 0) {
		// LOG_DBG("Write led: Incorrect data offset");
		return BT_GATT_ERR(BT_ATT_ERR_INVALID_OFFSET);
	}
	if (led_cb.led_cb) {
		//Read the received value 
		uint8_t val = *((uint8_t *)buf);
		if (val == 0x00 || val == 0x01) {
			//Call the application callback function to update the LED state
			led_cb.led_cb(val ? true : false);
		} else {
			// LOG_DBG("Write led: Incorrect value");
			return BT_GATT_ERR(BT_ATT_ERR_VALUE_NOT_ALLOWED);
		}
	}
	return len;
}

/********Register callback*************/
void register_callback()
{
    // Registering Callbacks
    bt_conn_cb_register(&connection_callbacks);
}

/* A function to register application callbacks for the LED characteristics  */
int my_led_service_init(struct my_led_cb *callbacks)
{
	if (callbacks) {
		led_cb.led_cb    = callbacks->led_cb;
		// lbs_cb.button_cb = callbacks->button_cb;
	}

	return 0;
}

/*-----LED Service Characteristic declaration---------*/
BT_GATT_SERVICE_DEFINE(sachin_demo_led, BT_GATT_PRIMARY_SERVICE(BT_UUID_DS), 
                        BT_GATT_CHARACTERISTIC(BT_UUID_LED, 
                                                BT_GATT_CHRC_WRITE,
                                                BT_GATT_PERM_WRITE,
                                                NULL, write_led_callback, NULL));
```

## src/ble_service.h
```c
#ifndef BLE_SERVICE_H
#define BLE_SERVICE_H

// Define BLE Service (Demo Service)
#define BT_UUID_DS_VAL BT_UUID_128_ENCODE(0x00001528, 0x1212, 0xefde, 0x1523, 0x785feabcd123)

// LED Characteristic UUID
#define BT_UUID_LED_VAL BT_UUID_128_ENCODE(0x00001529, 0x1212, 0xefde, 0x1523, 0x785feabcd123)

#define BT_UUID_DS BT_UUID_DECLARE_128(BT_UUID_DS_VAL)
#define BT_UUID_LED BT_UUID_DECLARE_128(BT_UUID_LED_VAL)


/*----Call back functions for connection and disconnection------*/
void on_connected(struct bt_conn *conn, uint8_t err);
void on_disconnected(struct bt_conn *conn, uint8_t reason);


/****Register Callback*****/
void register_callback(void);

/*------for LED Characteristic----------*/
/** @brief Callback type for when an LED state change is received. */
typedef void (*led_cb_t)(const bool led_state);

/** @brief Callback struct used by the Service. */
struct my_led_cb {
	/** LED state change callback. */
	led_cb_t    led_cb;
	// /** Button read callback. */
	// button_cb_t button_cb;
};

/** @brief Initialize the LBS Service.
 *
 * This function registers application callback functions with the My LBS
 * Service 
 *
 * @param[in] callbacks Struct containing pointers to callback functions
 *			used by the service. This pointer can be NULL
 *			if no callback functions are defined.
 *
 *
 * @retval 0 If the operation was successful.
 *           Otherwise, a (negative) error code is returned.
 */
int my_led_service_init(struct my_led_cb *callbacks);



#endif
```

## src/gpio_operations.c
```c
#include"headers.h"


//------get the pointer to the LEDs-----------
static const struct gpio_dt_spec blueLED = GPIO_DT_SPEC_GET(BLUE_LED, gpios);
static const struct gpio_dt_spec greenLED = GPIO_DT_SPEC_GET(GREEN_LED, gpios);

//---------For built-in LEDs---------
static const struct gpio_dt_spec builtInLED1 = GPIO_DT_SPEC_GET(built_in_LED1, gpios);
static const struct gpio_dt_spec builtInLED2 = GPIO_DT_SPEC_GET(built_in_LED2, gpios);

//---------For BLE LED---------------
static const struct gpio_dt_spec bleLED = GPIO_DT_SPEC_GET(BLE_LED, gpios);

void gpio_intial_values()
{
    gpio_pin_set_dt(&blueLED, 0);
    gpio_pin_set_dt(&greenLED, 0);
    gpio_pin_set_dt(&builtInLED1, 0);
    gpio_pin_set_dt(&builtInLED2, 0);
    gpio_pin_set_dt(&bleLED, 0);
}

void gpio_configure()
{
    printf("Inside GPIO Configurations\r\n");

    // Wait for the device to be ready
    if (!device_is_ready(blueLED.port)) {
		return;
	}
    if (!device_is_ready(greenLED.port)) {
		return;
	}

    //----for built-in LEDs-------
    // Wait for the device to be ready
    if (!device_is_ready(builtInLED1.port)) {
		return;
	}
    if (!device_is_ready(builtInLED2.port)) {
		return;
	}

	// Set the direction of GPIOs
	gpio_pin_configure_dt(&blueLED, GPIO_OUTPUT);
    gpio_pin_configure_dt(&greenLED, GPIO_OUTPUT);

    gpio_pin_configure_dt(&builtInLED1, GPIO_OUTPUT);
    gpio_pin_configure_dt(&builtInLED2, GPIO_OUTPUT);

    gpio_pin_configure_dt(&bleLED, GPIO_OUTPUT);

    // Give initial values on LEDs
    gpio_intial_values();
}

/*
    toggle both LEDs
*/
void toggle_both()
{
    gpio_pin_toggle_dt(&blueLED);
    gpio_pin_toggle_dt(&greenLED);
}

/*
    Turn LED ON/OFF
*/
void turn_green_led_on_off(int val)
{
    printf("Writing %d to green LED\n", val);
    gpio_pin_set_dt(&greenLED, val);

    gpio_pin_set_dt(&builtInLED1, val);
}

void turn_ble_led_on_off(int val)
{
    gpio_pin_set_dt(&bleLED, val);
}
```

## src/gpio_operations.h
```c
#ifndef GPIO_OPERATIONS_H
#define GPIO_OPERATIONS_H

/* LED Delay */
#define LED_DELAY   5000

//-----get the node reference----
#define BLUE_LED DT_ALIAS(blueled)
#define GREEN_LED DT_ALIAS(greenled)

//-----Built IN LED----------
#define built_in_LED1 DT_ALIAS(led0)
#define built_in_LED2 DT_ALIAS(led1)

//------BLE LED----------
#define BLE_LED DT_ALIAS(led3)

/*
    This function sets the initial values to the GPIO Pins
*/
void gpio_intial_values(void);

/*
    This function will set the GOPIO configurations
*/
void gpio_configure(void);

/*
    This function toggle both the LEDs
*/
void toggle_both(void);

/*
    Turn LED ON/OFF
*/
void turn_green_led_on_off(int);

/*
    Turn BLE LED ON/OFF
*/
void turn_ble_led_on_off(int);

#endif
```

## src/headers.h
```c
#include <stdio.h>
#include <zephyr/kernel.h>
// #include <zephyr/logging/log.h>
#include <zephyr/drivers/gpio.h>
#include <zephyr/bluetooth/bluetooth.h>
#include <zephyr/bluetooth/gap.h>
#include <zephyr/bluetooth/uuid.h>
#include <zephyr/bluetooth/conn.h>
#include <zephyr/bluetooth/addr.h>

#include <zephyr/bluetooth/gatt.h>

/*---My Custom Functions----*/
#include "gpio_operations.h"
#include "ble_operations.h"
#include "ble_advertise.h"
#include "ble_service.h"
#include "LED_service_functions.h"

/***********/
#define IDLE_DELAY 100 // milliseconds
```
